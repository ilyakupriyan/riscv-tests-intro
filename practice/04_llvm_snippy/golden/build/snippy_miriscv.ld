OUTPUT_ARCH("riscv")
ENTRY(_start)

MEMORY
{
  RAM (rwx) : ORIGIN = 0x80000000, LENGTH = 2M
}

SECTIONS
{
  . = 0x80000000;

  .text.init : {
    KEEP(*(.text.init))
  } > RAM

  /* Top of stack section from snippy.yaml: 0x80081000 + 0x6000 */
  __stack_top = 0x80087000;

  .tohost 0x80100000 : {
    KEEP(*(.tohost))
  } > RAM
}

/* Linker script generated by llvm-snippy, searched in -L directories */
INCLUDE snippy.elf.ld
